// frontend.c - see frontend.h. Formulas: handoff/features_spec.md (v1.2).
// One source for the board (bundles built by tools/build_flash.py), the virtual MCU (tools/vmcu) and the PC
// simulator (tools/vmcu/host_bundle.py). The stub sketch (no BUNDLE_ID) needs no front end, so on the board this
// file is empty unless a bundle is being built; that keeps the M0 smoke-test build free of generated headers.
#include "frontend.h"

#if !defined(ARDUINO) || defined(BUNDLE_ID)

#include <math.h>
#include <string.h>

#include "arm_math.h"
#include "arm_const_structs.h"
#include "hann_1024.h"   // g_hann_1024[1024], generated by ml/export_handoff.py

static arm_rfft_fast_instance_f32 s_rfft;
static arm_rfft_fast_instance_f32 s_rfft256;   // R4 envelope spectrum
static float s_buf[FE_N];   // windowed input (arm_rfft_fast_f32 overwrites its input); R4 reuses it as scratch
static float s_spec[FE_N];  // packed rFFT output: [Re X0, Re X512, Re X1, Im X1, ..., Re X511, Im X511]
static float s_hann256[FE_ENV_NB];

int fe_init(void) {
  if (arm_rfft_fast_init_f32(&s_rfft, FE_N) != ARM_MATH_SUCCESS) return -1;
  if (arm_rfft_fast_init_f32(&s_rfft256, FE_ENV_NB) != ARM_MATH_SUCCESS) return -1;
  // Symmetric Hann, evaluated in double and rounded once to float (spec v1.2, R4 step 4). Setup only, never timed.
  for (int m = 0; m < FE_ENV_NB; ++m)
    s_hann256[m] = (float)(0.5 - 0.5 * cos(2.0 * 3.14159265358979323846 * (double)m / (double)(FE_ENV_NB - 1)));
  return 0;
}

uint32_t fe_static_ram_bytes(void) {
  return (uint32_t)(sizeof s_rfft + sizeof s_rfft256 + sizeof s_buf + sizeof s_spec + sizeof s_hann256);
}

void fe_r0(const float *x, float mu, float sigma, float *out) {
  const float inv = 1.0f / sigma;
  for (int i = 0; i < FE_N; ++i) out[i] = (x[i] - mu) * inv;
}

void fe_r1(const float *x, float *f) {
  // Two-pass: mean first, then central moments (a single-pass raw-moment formula loses precision in float32).
  float sum = 0.0f, sumsq = 0.0f, sumabs = 0.0f, mx = x[0], mn = x[0];
  for (int i = 0; i < FE_N; ++i) {
    const float v = x[i];
    sum += v;
    sumsq += v * v;
    sumabs += fabsf(v);
    if (v > mx) mx = v;
    if (v < mn) mn = v;
  }
  const float n = (float)FE_N;
  const float mu = sum / n;
  float m2 = 0.0f, m3 = 0.0f, m4 = 0.0f;
  for (int i = 0; i < FE_N; ++i) {
    const float d = x[i] - mu;
    const float d2 = d * d;
    m2 += d2;
    m3 += d2 * d;
    m4 += d2 * d2;
  }
  const float rms = sqrtf(sumsq / n);
  const float s2 = m2 / n;
  const float s = sqrtf(s2);
  const float peak = fmaxf(fabsf(mx), fabsf(mn));
  const float mabs = sumabs / n;
  f[0] = mu;
  f[1] = rms;
  f[2] = s;
  f[3] = peak;
  f[4] = mx - mn;
  f[5] = peak / rms;
  f[6] = (m4 / n) / (s2 * s2);   // kurtosis, not excess
  f[7] = (m3 / n) / (s2 * s);    // skewness
  f[8] = rms / mabs;             // shape factor
  f[9] = peak / mabs;            // impulse factor
}

static void spectrum(const float *x) {
  for (int i = 0; i < FE_N; ++i) s_buf[i] = x[i] * g_hann_1024[i];
  arm_rfft_fast_f32(&s_rfft, s_buf, s_spec, 0);
}

void fe_r2(const float *x, float *f) {
  fe_r1(x, f);
  spectrum(x);
  // Band b = bins 32b .. 32b+31, b = 0..13 (0-5250 Hz); bin 0 is real-only (s_spec[0]). Bands 14-15 (spec v1.0)
  // lie in the stop-band of the common 5 kHz low-pass, below float32 FFT precision, and were dropped in v1.1.
  for (int b = 0; b < FE_R2_BANDS; ++b) {
    float acc = 0.0f;
    for (int k = 32 * b; k < 32 * b + 32; ++k) {
      if (k == 0) {
        acc += s_spec[0] * s_spec[0];
      } else {
        const float re = s_spec[2 * k], im = s_spec[2 * k + 1];
        acc += re * re + im * im;
      }
    }
    f[10 + b] = log10f(acc + 1e-12f);
  }
}

void fe_r3(const float *x, float *f) {
  spectrum(x);
  arm_cmplx_mag_f32(&s_spec[2], f, 256);           // |X[k]|, k = 1..256 (unpacked from element 2 on)
  for (int k = 0; k < 256; ++k) f[k] = log10f(f[k] + 1e-6f);
}

void fe_r4(const float *x, float *f) {
  fe_r1(x, f);
  memcpy(s_buf, x, sizeof s_buf);                                // step 1: un-windowed 1024-point rFFT
  arm_rfft_fast_f32(&s_rfft, s_buf, s_spec, 0);
  // step 2: bins 171..426 (2.0-5.0 kHz) as a 256-point complex baseband signal; X[k] = s_spec[2k], s_spec[2k+1]
  memcpy(s_buf, &s_spec[2 * FE_ENV_K0], 2u * FE_ENV_NB * sizeof(float));
  arm_cfft_f32(&arm_cfft_sR_f32_len256, s_buf, 1, 1);             // step 3: inverse cFFT (includes the 1/256)
  float *env = &s_spec[0];
  arm_cmplx_mag_f32(s_buf, env, FE_ENV_NB);                       // envelope, 256 samples at 3 kHz
  float mean = 0.0f;
  for (int m = 0; m < FE_ENV_NB; ++m) mean += env[m];
  mean /= (float)FE_ENV_NB;
  float *u = &s_spec[FE_ENV_NB];                                   // step 4: remove the mean, Hann
  for (int m = 0; m < FE_ENV_NB; ++m) u[m] = (env[m] - mean) * s_hann256[m];
  float *U = &s_spec[2 * FE_ENV_NB];                               // step 5: packed 256-point rFFT
  arm_rfft_fast_f32(&s_rfft256, u, U, 0);
  float *E = &s_buf[0];
  arm_cmplx_mag_f32(&U[2], E, FE_ENV_NK);                          // |E[k]|, k = 1..32
  float sum = 0.0f;
  for (int k = 0; k < FE_ENV_NK; ++k) sum += E[k];
  const float inv_mean = (float)FE_ENV_NK / sum;                   // step 6: shape only, then log
  for (int k = 0; k < FE_ENV_NK; ++k) f[10 + k] = log10f(E[k] * inv_mean + 1e-6f);
}

void fe_zscore(float *f, const float *mean, const float *std, int n) {
  for (int i = 0; i < n; ++i) f[i] = (f[i] - mean[i]) / std[i];
}

#endif  // !ARDUINO || BUNDLE_ID
